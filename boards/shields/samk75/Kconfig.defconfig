## boards/shields/samk75/Kconfig.defconfig
```kconfig
# Copyright (c) 2020 The ZMK Contributors
# SPDX-License-Identifier: MIT

if SHIELD_SAMK75

config ZMK_KEYBOARD_NAME
    default "SamK 75"

config I2C
    default y

config LED
    default y

config IS31FL3731
    default y

endif
```

## boards/shields/samk75/Kconfig.shield
```kconfig
# Copyright (c) 2020 The ZMK Contributors
# SPDX-License-Identifier: MIT

config SHIELD_SAMK75
    def_bool $(shields_list_contains,samk75)
```
